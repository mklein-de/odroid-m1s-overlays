/* Enable GPIO LED connected to pin 12 */

/dts-v1/;
/plugin/;

/ {
	compatible = "rockchip,rk3566-odroid-m1";

	fragment@0 {
		target-path = "/";

		__overlay__ {
			leds {
				gpio-led {
					label = "relay:mains";
					gpios = <&gpio2 7 0>;
					linux,default-trigger = "none";
				};
			};
		};
	};

	__fixups__ {
		gpio2 = "/fragment@0/__overlay__/leds/gpio-led:gpios:0";
	};
};
